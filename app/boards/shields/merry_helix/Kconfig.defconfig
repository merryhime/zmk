## app/boards/shields/merry_helix/Kconfig.defconfig
```kconfig
# Copyright (c) 2020 The ZMK Contributors
# SPDX-License-Identifier: MIT

if SHIELD_MERRY_HELIX

config ZMK_KEYBOARD_NAME
    default "Helix (maryart)"

endif
```

## app/boards/shields/merry_helix/Kconfig.shield
```kconfig
# Copyright (c) 2020 The ZMK Contributors
# SPDX-License-Identifier: MIT

config SHIELD_MERRY_HELIX
    def_bool $(shields_list_contains,merry_helix)
```
